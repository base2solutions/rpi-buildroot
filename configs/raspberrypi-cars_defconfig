## configs/raspberrypi-cars_defconfig
```kconfig
BR2_arm=y
BR2_arm1176jzf_s=y
BR2_ARM_EABIHF=y
BR2_KERNEL_HEADERS_VERSION=y
BR2_DEFAULT_KERNEL_VERSION="3.6.11"
BR2_TOOLCHAIN_BUILDROOT_EGLIBC=y
BR2_EXTRA_GCC_CONFIG_OPTIONS="--with-float=hard"
BR2_TARGET_OPTIMIZATION="-pipe -mhard-float"
BR2_TOOLCHAIN_BUILDROOT_CXX=y
BR2_TARGET_GENERIC_HOSTNAME="cars"
BR2_TARGET_GENERIC_ISSUE=""
BR2_ROOTFS_DEVICE_CREATION_DYNAMIC_DEVTMPFS=y
BR2_TARGET_GENERIC_GETTY_PORT="ttyAMA0"
BR2_ROOTFS_OVERLAY="board/raspberrypi/overlay"
BR2_ROOTFS_POST_BUILD_SCRIPT="board/raspberrypi/postscript.sh"
BR2_PACKAGE_W_SCAN=y
BR2_PACKAGE_BLUEZ_UTILS=y
BR2_PACKAGE_BLUEZ_UTILS_COMPAT=y
BR2_PACKAGE_BLUEZ_UTILS_USB=y
BR2_PACKAGE_IW=y
BR2_PACKAGE_OPENSSH=y
BR2_PACKAGE_WIRELESS_REGDB=y
BR2_PACKAGE_WIRELESS_TOOLS=y
BR2_PACKAGE_WIRELESS_TOOLS_LIB=y
BR2_PACKAGE_WPA_SUPPLICANT=y
BR2_PACKAGE_WPA_SUPPLICANT_EAP=y
BR2_PACKAGE_WPA_SUPPLICANT_CLI=y
BR2_PACKAGE_WPA_SUPPLICANT_PASSPHRASE=y
BR2_PACKAGE_WPA_SUPPLICANT_AP_SUPPORT=y
BR2_PACKAGE_WPA_SUPPLICANT_WPS=y
BR2_PACKAGE_RPI_USERLAND=y
BR2_PACKAGE_ORACLE_JDK8=y
BR2_TARGET_RPI=y
BR2_LINUX_KERNEL=y
BR2_LINUX_KERNEL_CUSTOM_VERSION=y
BR2_LINUX_KERNEL_CUSTOM_VERSION_VALUE="3.6.11"
BR2_LINUX_KERNEL_PATCH="http://dl.guillermoamaral.com/rpi/kernel-3.6.11.patch"
BR2_LINUX_KERNEL_DEFCONFIG="bcmrpi"
BR2_LINUX_KERNEL_ZIMAGE=y
```

## package/jetty/Config.in
```kconfig
config BR2_PACKAGE_JETTY
	bool "jetty"
	select BR2_PACKAGE_ORACLE_JDK8
  select BR2_PACKAGE_BASH
	help
	  Jetty servlet container.

	  http://www.eclipse.org/jetty/
```

## package/obd2/Config.in
```kconfig
config BR2_PACKAGE_OBD2
	bool "obd2"
	select BR2_PACKAGE_JETTY
	help
	  OBD2 in-car service.

	  http://github.com/base2solutions/obd2-in-car-service
```

## package/oracle-jdk8/Config.in
```kconfig
config BR2_PACKAGE_ORACLE_JDK8
	bool "Oracle JDK 8"
	depends on BR2_TOOLCHAIN_BUILDROOT_EGLIBC
	depends on BR2_arm
	help
	  Oracle JDK 8.

	  http://jdk8.java.net/
```
